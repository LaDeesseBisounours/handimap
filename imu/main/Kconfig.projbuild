## imu/main/Kconfig.projbuild
```kconfig
menu "Example Configuration"

    menu "I2C Master"
        config I2C_MASTER_SCL
            int "SCL GPIO Num"
            default 19
            help
                GPIO number for I2C Master clock line.

        config I2C_MASTER_SDA
            int "SDA GPIO Num"
            default 18
            help
                GPIO number for I2C Master data line.

        config I2C_MASTER_PORT_NUM
            int "Port Number"
            default 1
            help
                Port number for I2C Master device.

        config I2C_MASTER_FREQUENCY
            int "Master Frequency"
            default 100000
            help
                I2C Speed of Master device.
    endmenu

    menu "ICM20948 Sensor"
        choice ICM20948_ADDR
            prompt "ICM20948 I2C Address"
            default ICM20948_I2C_ADDRESS_LOW
            help
                Hardware address of ICM20948, which is 2 types, and determined by ADDR terminal.

            config ICM20948_I2C_ADDRESS_LOW
                bool "ICM20948 I2C Address(ADDR=0)"
                help
                    I2C Address of ICM20948 Sensor according to your schemetic configuration.

            config ICM20948_I2C_ADDRESS_High
                bool "ICM20948 I2C Address(ADDR=1)"
                help
                    I2C Address of ICM20948 Sensor according to your schemetic configuration.
        endchoice

        config ICM20948_ADDR
            hex
            default 0x69 if ICM20948_I2C_ADDRESS_High
            default 0x68 if ICM20948_I2C_ADDRESS_LOW

            endmenu

endmenu
```
